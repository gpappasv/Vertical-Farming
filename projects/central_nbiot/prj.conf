## CMakeLists.txt
```
# SPDX-License-Identifier: Apache-2.0

cmake_minimum_required(VERSION 3.20.0)

find_package(Zephyr REQUIRED HINTS $ENV{ZEPHYR_BASE})
project(central_nbiot)

target_sources(app PRIVATE src/main.c internal_uart/internal_uart.c ../common/com_protocol/com_protocol.c internal_uart/message_parsing.c inventory/inventory.c coap_client/coap_client.c coap_client/coap_fsm.c coap_client/coap_message_parsing.c gpioif/gpio_interface.c timestamp_module/timestamp.c)
```

## prj.conf
```kconfig
CONFIG_SERIAL=y

# General config
CONFIG_HEAP_MEM_POOL_SIZE=4096
CONFIG_NEWLIB_LIBC=y
CONFIG_BUILD_WITH_TFM=y

# Networking
CONFIG_NETWORKING=y
CONFIG_NET_NATIVE=n
CONFIG_NET_SOCKETS_OFFLOAD=y
CONFIG_NET_SOCKETS=y
CONFIG_NET_SOCKETS_POSIX_NAMES=y
CONFIG_MBEDTLS_PSA_CRYPTO_C=y
# LTE link control
CONFIG_LTE_LINK_CONTROL=y

# LTE parameters
## Network Mode / LTE category
CONFIG_LTE_NETWORK_MODE_NBIOT=y
CONFIG_LTE_LC_MODEM_SLEEP_NOTIFICATIONS=y

# Modem library
CONFIG_NRF_MODEM_LIB=y

# CoAP
CONFIG_COAP=y
CONFIG_AT_HOST_LIBRARY=y

# Main thread
CONFIG_MAIN_STACK_SIZE=4096

CONFIG_NET_IPV6=y

# LOGGING
CONFIG_LOG=y

# Power management
CONFIG_PM_DEVICE=y
CONFIG_EVENTS=y

# CALENDAR TIME
CONFIG_DATE_TIME=y
CONFIG_DATE_TIME_AUTO_UPDATE=y

# STATE MACHINE FRAMEWORK
CONFIG_SMF=y

CONFIG_GPIO=y
CONFIG_SYSTEM_WORKQUEUE_STACK_SIZE=4096
CONFIG_LTE_NETWORK_TIMEOUT=1200
CONFIG_NET_SOCKETS_CONNECT_TIMEOUT=10000
CONFIG_THREAD_NAME=y
CONFIG_CRC=y
```

## nrf9160dk_nrf9160.overlay
```dts
// To get started, press Ctrl+Space to bring up the completion menu and view the available nodes.
// For more help, browse the DeviceTree documentation at https://docs.zephyrproject.org/latest/guides/dts/index.html
&uart2 {
	compatible = "nordic,nrf-uarte";
	current-speed = <115200>;
	status = "okay";
};

&uart2_default {
    group1 {
        psels = <NRF_PSEL(UART_TX, 0, 18)>,
                <NRF_PSEL(UART_RX, 0, 17)>,
                <NRF_PSEL(UART_RTS, 0, 21)>,
                <NRF_PSEL(UART_CTS, 0, 19)>;
    };
};
```

## nrf9160dk_nrf9160_ns.overlay
```dts
// To get started, press Ctrl+Space to bring up the completion menu and view the available nodes.
// For more help, browse the DeviceTree documentation at https://docs.zephyrproject.org/latest/guides/dts/index.html
&uart2 {
	compatible = "nordic,nrf-uarte";
	current-speed = <115200>;
	status = "okay";
};

&gpio0 {
    status = "okay";
};

&uart2_default {
    group1 {
        psels = <NRF_PSEL(UART_TX, 0, 18)>,
                <NRF_PSEL(UART_RX, 0, 17)>,
                <NRF_PSEL(UART_RTS, 0, 21)>,
                <NRF_PSEL(UART_CTS, 0, 19)>;
    };
};
```

## src/main.c
```c
// --- includes ----------------------------------------------------------------
#include <zephyr/kernel.h>
#include "../internal_uart/internal_uart.h"
#include "../gpioif/gpio_interface.h"
#include <nrf_modem_at.h>
#include <zephyr/logging/log.h>
#include <modem/lte_lc.h>

// --- logging settings --------------------------------------------------------
LOG_MODULE_REGISTER(main_m);

// --- functions definitions ---------------------------------------------------
static void modem_connect(void)
{
	int ret;

	do {

		LOG_INF("Connecting to network.");
		LOG_INF("This may take several minutes.");

		ret = lte_lc_connect();
		if (ret < 0) {
			LOG_WRN("Failed to establish LTE connection (%d).", ret);
			LOG_WRN("Will retry in a minute.");
			lte_lc_offline();
			k_sleep(K_SECONDS(60));
		}
	} while (ret < 0);
}

int main(void)
{
    modem_connect();
    internal_uart_init();
    gpio_row_control_init();
    return 0;
}
```
