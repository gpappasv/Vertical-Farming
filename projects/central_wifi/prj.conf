## CMakeLists.txt
```
cmake_minimum_required(VERSION 3.20.0)
find_package(Zephyr REQUIRED HINTS $ENV{ZEPHYR_BASE})

project(central_wifi)

target_sources(app PRIVATE 
src/main.c
src/watchdog_timer/watchdog_timer.c
src/ble_client/ble_fsm.c 
src/ble_client/ble_conn_control.c 
src/ble_client/ble_characteristic_control.c 
src/ble_client/ble_connection_data.c
src/flash_system/flash_system.c
src/measurements/measurements_fsm.c 
src/measurements/measurements_data_storage.c 
src/measurements/measurements_fsm_timer.c
../common/com_protocol/com_protocol.c
src/environment_control/environment_control_config.c
src/environment_control/environment_control_fsm.c
src/wifi_config/wifi_config.c
src/wifi_config/wifi_apis.c
src/cloud_data_inventory/inventory.c
src/timestamp_module/timestamp.c
src/coap_client/coap_client.c
src/coap_client/coap_fsm.c
src/coap_client/coap_message_parsing.c
)

target_include_directories(app PRIVATE 
${CMAKE_SOURCE_DIR}/../common
${CMAKE_SOURCE_DIR}/../common/com_protocol
${CMAKE_SOURCE_DIR}/src)

# Optimise for debug
set(CMAKE_CXX_FLAGS "${CMAKE_CXX_FLAGS} -O0")
```

## prj.conf
```kconfig
#
# Copyright (c) 2023 Nordic Semiconductor ASA
#
# SPDX-License-Identifier: LicenseRef-Nordic-5-Clause
#

# Configuration file for nRF7002 DK
# This file is merged with prj.conf in the application folder, and options
# set here will take precedence if they are present in both files.

# General
CONFIG_FLASH=y
CONFIG_FLASH_PAGE_LAYOUT=y
CONFIG_FLASH_MAP=y
CONFIG_NVS=y
CONFIG_SOC_FLASH_NRF_PARTIAL_ERASE=y

# Serial Peripheral Interface (SPI) - Used to communicate with the mx25r64 external flash memory.
CONFIG_SPI=y
CONFIG_SPI_NOR=y
CONFIG_SPI_NOR_SFDP_DEVICETREE=y
CONFIG_PM_OVERRIDE_EXTERNAL_DRIVER_CHECK=y

# Bootloader and FOTA related configurations

# MCUBOOT
CONFIG_BOOTLOADER_MCUBOOT=y
CONFIG_MCUBOOT_USE_ALL_AVAILABLE_RAM=y
CONFIG_MCUBOOT_IMG_MANAGER=y

# Image manager
CONFIG_IMG_MANAGER=y
CONFIG_STREAM_FLASH=y
CONFIG_IMG_ERASE_PROGRESSIVELY=y
CONFIG_MAIN_STACK_SIZE=4096
CONFIG_MCUMGR=y
CONFIG_ZCBOR=y
CONFIG_MCUMGR_GRP_IMG=y
CONFIG_MCUMGR_TRANSPORT_UDP=y
CONFIG_MCUMGR_TRANSPORT_UDP_AUTOMATIC_INIT=y
CONFIG_MCUMGR_TRANSPORT_UDP_PORT=1337
CONFIG_MCUMGR_TRANSPORT_UDP_IPV4=y
CONFIG_MCUMGR_TRANSPORT_UDP_IPV6=y
CONFIG_MCUMGR_GRP_OS=y
CONFIG_SMP_CLIENT=y
CONFIG_MCUMGR_GRP_OS_CLIENT=y
CONFIG_MCUMGR_GRP_OS_CLIENT_RESET=y
CONFIG_MCUMGR_GRP_OS_ECHO=y

# BT settings
CONFIG_BT=y
CONFIG_BT_CENTRAL=y
CONFIG_BT_GATT_CLIENT=y
# TODO: Do we need this setting for stack size? Adjust the value
CONFIG_BT_RX_STACK_SIZE=4096
CONFIG_BT_USER_PHY_UPDATE=y
CONFIG_BT_MAX_CONN=20

# Logging
CONFIG_LOG=y
# State machine framework
CONFIG_SMF=y

# Watchdog settings
CONFIG_WATCHDOG=y
CONFIG_WDT_DISABLE_AT_BOOT=y

# Enable events
CONFIG_EVENTS=y

# Generic networking options
CONFIG_NETWORKING=y
CONFIG_REQUIRES_FULL_LIBC=y
CONFIG_NET_IPV6=y
CONFIG_NET_IPV4=y
CONFIG_NET_DHCPV4=y
CONFIG_NET_DHCPV6=y
CONFIG_NET_UDP=y

CONFIG_NET_SOCKETS=y
CONFIG_NET_SOCKETS_POSIX_NAMES=y
CONFIG_NET_SOCKETS_POLL_MAX=12

CONFIG_COAP=y

# Network Shell
CONFIG_NET_SHELL=y

CONFIG_NET_CONFIG_SETTINGS=y
CONFIG_NET_CONFIG_NEED_IPV6=y
CONFIG_NET_CONFIG_INIT_TIMEOUT=0

# Wi-Fi
CONFIG_WIFI=y
CONFIG_WIFI_NRF700X=y
CONFIG_WPA_SUPP=y
CONFIG_NET_L2_ETHERNET=y
CONFIG_NET_LOG=n
CONFIG_NRF700X_STA_MODE=y
CONFIG_NET_L2_WIFI_MGMT=y
CONFIG_NET_DEFAULT_IF_WIFI=y
CONFIG_INIT_STACKS=y
CONFIG_NET_IF_UNICAST_IPV4_ADDR_COUNT=2
CONFIG_NET_IF_UNICAST_IPV6_ADDR_COUNT=4
CONFIG_NET_MAX_CONTEXTS=12
CONFIG_NET_MAX_CONN=16
CONFIG_NET_CONTEXT_SYNC_RECV=y
CONFIG_NET_CONFIG_AUTO_INIT=y
CONFIG_WEBSOCKET_CLIENT=y
# Connection manager
CONFIG_NET_CONNECTION_MANAGER=y

CONFIG_GPIO=y
# CONFIG_POSIX_API=y
CONFIG_SNTP=y
CONFIG_NET_CONFIG_CLOCK_SNTP_INIT=y
CONFIG_NET_CONFIG_SNTP_INIT_SERVER="nl.pool.ntp.org"
CONFIG_NET_CONFIG_PEER_IPV6_ADDR="2001:4860:4806:4::"
```

## nrf7002dk_nrf5340_cpuapp.overlay
```dts
/*
 * Copyright (c) 2023 Nordic Semiconductor ASA
 *
 * SPDX-License-Identifier: LicenseRef-Nordic-5-Clause
 */

/ {
	/* Configure the partition manager to use the mx25r64 external flash memory. */
	chosen {
		nordic,pm-ext-flash = &mx25r64;
	};

	aliases {
        watchdog = &wdt;
	};
};

&mx25r64 {
	status = "okay";
};
```

## src/main.c
```c
#include <zephyr/kernel.h>

#include "watchdog_timer/watchdog_timer.h"
#include "flash_system/flash_system.h"
#include "measurements/measurements_fsm_timer.h"
#include <zephyr/logging/log.h>
#include "wifi_config/wifi_apis.h"
LOG_MODULE_REGISTER(main_m);

int main(void)
{
    // Init watchdog
    init_watchdog();
    // Init flash system
    flash_system_init();

    // Start the measurements fsm
    init_measurements_fsm_timer();
    start_measurements_fsm_timer();

    // Init wifi and trigger wifi connection
    wifi_apis_wifi_init();
    wifi_apis_connect();

    return 0;
}
```
